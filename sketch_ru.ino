// ============================================
// УПРАВЛЕНИЕ ШАГОВЫМ ДВИГАТЕЛЕМ 28BYJ-48
// С ПОТЕНЦИОМЕТРОМ
// ============================================

// --- НАСТРОЙКИ ДЕБАГА ---
// Раскомментируйте следующую строку для включения отладки
// #define DEBUG

// --- ПОДКЛЮЧЕНИЕ АППАРАТУРЫ ---
// Потенциометр: средний вывод потенциометра -> аналоговый пин Arduino A0
// Крайние выводы: GND и 5V в Arduino
#define SENSOR_PIN A0 

// Драйвер ULN2003:
// Вход драйвера|Цифровой пин Arduino|
// ----------------------------------|
// IN1          | PIN_8              |
// IN2          | PIN_9              |
// IN3          | PIN_10             |
// IN4          | PIN_11             |
#define PIN_1 8
#define PIN_2 9
#define PIN_3 10
#define PIN_4 11

// --- НАСТРОЙКИ ДВИЖЕНИЯ ---
// Время задержки между микрошагами (миллисекунды)
// Рекомендации:
// 1-2 мс - быстро, но может пропускать шаги
// 3-5 мс - оптимально для 28BYJ-48
#define DELAY_TIME 1

// Верхняя граница напряжения потенциометра
// Если напряжение становится выше - мотор вращается по часовой стрелке
#define UPPER_LIMIT 600
// Верхняя граница напряжения потенциометра
// Если напряжение становится ниже - мотор вращается по часовой стрелке
// !Для правильной работы должно быть меньше верхнего лимита!
#define LOWER_LIMIT 500
// Если напряжение находится ниже верхней границы, но выше нижней
// Появляется "мертвая зона" т.е. среднее положение в котором мотор не вращается

// --- ТАБЛИЦА ПОЛУШАГОВ ---
// Последовательность для 28BYJ-48 (полушаговый режим)
// 8 состояний = 1 полный шаг
// Полный оборот = 4096 состояний
int seq[8][4] = {
  {1, 0, 0, 0},
  {1, 1, 0, 0},
  {0, 1, 0, 0},
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  {1, 0, 0, 1}
};

// ============================================
// SETUP - выполняется единожды 
// ============================================
void setup() {
  Serial.begin(9600); // Запускаем связь с компьютером
  #ifdef DEBUG
      Serial.println("Подключение к монитору порта выполнено"); 
  #endif
  // Инициализиция пинов  
  pinMode(PIN_1, OUTPUT);
  pinMode(PIN_2, OUTPUT);
  pinMode(PIN_3, OUTPUT);
  pinMode(PIN_4, OUTPUT);
}

// Текущее значение напряжения на аналоговом выводе, подключенном к потенциометру. 
int sensorValue = 0;

// ============================================
// LOOP - выполняется бесконечно
// ============================================
void loop() {
  sensorValue = analogRead(SENSOR_PIN); // Читаем значение (0-1023)

  // Вывод в монитор порта
  // Просмотр через комбинацию клавиш Ctrl+Shift+M 
  #ifdef DEBUG
      Serial.println(sensorValue); 
  #endif

  // Проверка преодоления напряжения на аналоговом пине верхней границы
  if (sensorValue >= UPPER_LIMIT){
    for (int step = 0; step < 8; step++) {
      // Вращение мотора по часовой стрелке      
      digitalWrite(PIN_1, seq[step][0]);
      digitalWrite(PIN_2, seq[step][1]);
      digitalWrite(PIN_3, seq[step][2]);
      digitalWrite(PIN_4, seq[step][3]);
      // Задержка между шагами     
      delay(DELAY_TIME);
    }
  // Проверка преодоления напряжения на аналоговом пине нижней границы
  } else if (sensorValue <= LOWER_LIMIT){
    for (int step = 7; step >= 0; step--) {
      // Вращение мотора против часовой стрелки
      digitalWrite(PIN_1, seq[step][0]);
      digitalWrite(PIN_2, seq[step][1]);
      digitalWrite(PIN_3, seq[step][2]);
      digitalWrite(PIN_4, seq[step][3]);
      // Задержка между шагами
      delay(DELAY_TIME); 
    }
  }
}